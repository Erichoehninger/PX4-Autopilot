## src/modules/sensor_can_publisher/Kconfig
```kconfig
config MODULES_SENSOR_CAN_PUBLISHER
	bool "Sensor CAN Publisher"
	default y
	help
	  Este módulo publica dados de sensores locais (IMU, GPS)
	  no barramento DroneCAN para fins de redundância.
```

## src/modules/tmr_can_manager/Kconfig
```kconfig
config MODULES_TMR_CAN_MANAGER
	bool "TMR CAN Manager"
	default y
	help
	  Módulo de gerenciamento de Tripla Redundância (TMR)
	  para comunicação CAN-FD e consenso de líder entre 3 controladoras.
```
